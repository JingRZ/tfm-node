## components/c_provisioning/Kconfig.projbuild
```kconfig
menu "Provisioning Configuration"

    choice PROV_TRANSPORT
        bool "Provisioning Transport"
        default EXAMPLE_PROV_TRANSPORT_SOFTAP if IDF_TARGET_ESP32S2
        default EXAMPLE_PROV_TRANSPORT_BLE
        help
            Wi-Fi provisioning component offers both, SoftAP and BLE transports. Choose any one.

        config EXAMPLE_PROV_TRANSPORT_BLE
            bool "BLE"
            select BT_ENABLED
            depends on !IDF_TARGET_ESP32S2
        config EXAMPLE_PROV_TRANSPORT_SOFTAP
            bool "Soft AP"
            select LWIP_IPV4
    endchoice

    choice PROV_SECURITY_VERSION
        bool "Protocomm security version"
        default PROV_SECURITY_VERSION_2
        help
            Wi-Fi provisioning component offers 3 security versions.
            The example offers a choice between security version 1 and 2.

        config PROV_SECURITY_VERSION_1
            bool "Security version 1"
            select ESP_PROTOCOMM_SUPPORT_SECURITY_VERSION_1

        config PROV_SECURITY_VERSION_2
            bool "Security version 2"
            select ESP_PROTOCOMM_SUPPORT_SECURITY_VERSION_2
    endchoice

    config PROV_TRANSPORT
        int
        default 1 if EXAMPLE_PROV_TRANSPORT_BLE
        default 2 if EXAMPLE_PROV_TRANSPORT_SOFTAP

    config PROV_RESET_MGR_ON_FAILURE
        bool
        default y
        prompt "Reset provisioned credentials and state machine after session failure"
        help
            Enable reseting provisioned credentials and state machine after session failure.
            This will restart the provisioning service after retries are exhausted.

    config PROV_MGR_MAX_RETRY_CNT
        int
        default 5
        prompt "Max retries before reseting provisioning state machine"
        depends on EXAMPLE_RESET_PROV_MGR_ON_FAILURE
        help
            Set the Maximum retry to avoid reconnecting to an inexistent AP or if credentials
            are misconfigured. Provisioned credentials are erased and internal state machine
            is reset after this threshold is reached.

    config PROV_SHOW_QR
        bool "Show provisioning QR code"
        default y
        help
            Show the QR code for provisioning.

endmenu
```

## components/c_wifi/Kconfig.projbuild
```kconfig
menu "WIFI Connection Configuration"

    config C_WIFI_SSID
        string "WiFi SSID"
        default "MiFibra-ED4A"
        help
            SSID (network name) to connect to.

    config C_WIFI_PWD
        string "WiFi Password"
        default "wMUS3eAS"
        help
            WiFi password (WPA or WPA2) to use.

    choice C_WIFI_SAE_MODE
        prompt "WPA3 SAE mode selection"
        default C_WIFI_WPA3_SAE_PWE_BOTH
        help
            Select mode for SAE as Hunt and Peck, H2E or both.
        config C_WIFI_WPA3_SAE_PWE_HUNT_AND_PECK
            bool "HUNT AND PECK"
        config C_WIFI_WPA3_SAE_PWE_HASH_TO_ELEMENT
            bool "H2E"
        config C_WIFI_WPA3_SAE_PWE_BOTH
            bool "BOTH"
    endchoice

    config C_WIFI_PWD_ID
        string "PASSWORD IDENTIFIER"
        depends on  C_WIFI_WPA3_SAE_PWE_HASH_TO_ELEMENT|| C_WIFI_WPA3_SAE_PWE_BOTH
        default ""
        help
            password identifier for SAE H2E

    config C_WIFI_MAXIMUM_RETRY
        int "Maximum retry"
        default 5
        help
            Set the Maximum retry to avoid station reconnecting to the AP unlimited when the AP is really inexistent.

    choice C_WIFI_SCAN_AUTH_MODE_THRESHOLD
        prompt "WiFi Scan auth mode threshold"
        default C_WIFI_AUTH_WPA2_PSK
        help
            The weakest authmode to accept in the scan mode.
            This value defaults to ESP_WIFI_AUTH_WPA2_PSK incase password is present and ESP_WIFI_AUTH_OPEN is used.
            Please select ESP_WIFI_AUTH_WEP/ESP_WIFI_AUTH_WPA_PSK incase AP is operating in WEP/WPA mode.

        config C_WIFI_AUTH_OPEN
            bool "OPEN"
        config C_WIFI_AUTH_WEP
            bool "WEP"
        config C_WIFI_AUTH_WPA_PSK
            bool "WPA PSK"
        config C_WIFI_AUTH_WPA2_PSK
            bool "WPA2 PSK"
        config C_WIFI_AUTH_WPA_WPA2_PSK
            bool "WPA/WPA2 PSK"
        config C_WIFI_AUTH_WPA3_PSK
            bool "WPA3 PSK"
        config C_WIFI_AUTH_WPA2_WPA3_PSK
            bool "WPA2/WPA3 PSK"
        config C_WIFI_AUTH_WAPI_PSK
            bool "WAPI PSK"
    endchoice

endmenu
```

## main/Kconfig.projbuild
```kconfig
menu "Com MQTT - Thingsboard Configuration"

    menu "Provisioning"

        config TB_PROVISION_USERNAME
            string "Thingsboard provision Username"
            default "provision"

        config TB_PROVISION_DEVICE_KEY
            string "Thingsboard device profile's provision key"
            default "2lkpfzzf7bpy74iwzn66"
            help
                Look at Device profiles -> select device -> Device provisioning

        config TB_PROVISION_DEVICE_SECRET
            string "Thingsboard device profile's provision secret"
            default "03mt3l6srz9bijscmr9n"
            help
                Look at Device profiles -> select device -> Device provisioning
            
        config TB_PROVISION_REQUEST_TOPIC
            string "Thingsboard provision request Topic"
            default "/provision/request"
            help
                Topic to publish your provisioning request
    
        config TB_PROVISION_RESPONSE_TOPIC
            string "Thingsboard provision response Topic"
            default "/provision/response"
            help
                Topic to subscribe to in order to receive the provision request's answer
    
    endmenu

    menu "Communication"
        config TB_TELEMETRY_TOPIC
            string "Thingsboard Telemetry Topic"
            default "v1/devices/me/telemetry"
            help
                Topic to publish/subscribe to in order to send telemetry to TB

        menu "Server Side RPC"
    
            config TB_SS_RPC_RESPONSE_TOPIC
                string "Thingsboard Server Side Response Topic"
                default "v1/devices/me/rpc/response/"
                help
                    Topic to publish/subscribe to in order to answer petitions from TB. End it with /

            config TB_SS_RPC_REQUEST_TOPIC
                string "Thingsboard Server Side Request Topic"
                default "v1/devices/me/rpc/request/+"

        endmenu

        menu "Client Side RPC"
            config TB_CS_RPC_REQUEST_TOPIC
                string "Thingsboard Client Side Request Topic"
                default "v1/devices/me/rpc/request/"
    
            config TB_CS_RPC_RESPONSE_TOPIC
                string "Thingsboard Client Side Response Topic"
                default "v1/devices/me/rpc/response/+"
        endmenu

        menu "Attributes"
            config TB_ATTR_TOPIC
                string "Thingsboard Attributes Request Topic"
                default "v1/devices/me/attributes"
                help
                    Topic to subscribe to receive attribute updates
    
            config TB_ATTR_RESPONSE_TOPIC
                string "Thingsboard Attributes Response Topic"
                default "v1/devices/me/attributes/response/+"
                help
                    Topic to subscribe to
        endmenu

        menu "OTA"
            config TB_OTA_FW_TOPIC
                string "Thingsboard OTA Firmware Topic"
                default "v2/fw/response/+"
                help
                    Topic to subscribe to to receive ota firmware updates
    
            config TB_OTA_SW_TOPIC
                string "Thingsboard OTA Software Topic"
                default "v2/sw/response/+"
                help
                    Topic to subscribe to to receive ota software updates
        endmenu

    endmenu

endmenu


menu "Com NVS Configuration"

    config NVS_KEY_TB_TOKEN
        string "Key associated with the access token provisioned by thingsboard"
        default "tb_prov_token"

    config NVS_KEY_TB_CTX
        string "Key associated with the node's context"
        default "tb_node_ctx"

endmenu
```
